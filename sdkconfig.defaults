## sdkconfig.defaults
```kconfig
# ---------- Target ----------
CONFIG_IDF_TARGET="esp32s3"
CONFIG_IDF_TARGET_ESP32S3=y

# ---------- CPU & Performance ----------
CONFIG_ESP32S3_DEFAULT_CPU_FREQ_240=y
CONFIG_FREERTOS_HZ=1000
CONFIG_FREERTOS_UNICORE=n

# ---------- Bluetooth ----------
CONFIG_BT_ENABLED=y
CONFIG_BT_NIMBLE_ENABLED=y
CONFIG_BT_NIMBLE_MEM_ALLOC_MODE_INTERNAL=y
CONFIG_BT_CONTROLLER_ENABLED=y
CONFIG_BTDM_CTRL_MODE_BLE_ONLY=y
CONFIG_BTDM_CTRL_BLE_MAX_CONN=3
CONFIG_BTDM_CTRL_BLE_MAX_CONN_EFF=3
CONFIG_BT_NIMBLE_MAX_CONNECTIONS=3
CONFIG_BT_NIMBLE_MAX_BONDS=3
CONFIG_BT_NIMBLE_ROLE_PERIPHERAL=y
CONFIG_BT_NIMBLE_ROLE_BROADCASTER=y
CONFIG_BT_NIMBLE_ROLE_CENTRAL=n
CONFIG_BT_NIMBLE_ROLE_OBSERVER=n
CONFIG_BT_NIMBLE_ATT_PREFERRED_MTU=200
CONFIG_BT_NIMBLE_GATT_MAX_PROCS=8
CONFIG_BT_NIMBLE_MAX_CCCDS=8
CONFIG_BT_NIMBLE_SVC_GAP_DEVICE_NAME="TomoPendant"

# Disable Bluedroid stack
CONFIG_BT_BLUEDROID_ENABLED=n
CONFIG_BT_BLUEDROID_SUPPORTED=n

# ---------- Wi-Fi (off by default, OTA will enable if needed) ----------
CONFIG_ESP_WIFI_ENABLED=n

# ---------- I²C ----------
CONFIG_I2C_ISR_IRAM_SAFE=y
CONFIG_I2C_ENABLE_DEBUG=y

# ---------- GPIO / Button ----------
CONFIG_GPIO_CTRL_FUNC_IN_IRAM=y

# ---------- Logging ----------
CONFIG_LOG_DEFAULT_LEVEL_INFO=y
CONFIG_LOG_COLORS=y

# ---------- NVS ----------
CONFIG_NVS_ENCRYPTION=n
CONFIG_NVS_FLASH=y

# ---------- Power Management ----------
CONFIG_PM_ENABLE=y
CONFIG_ESP_SLEEP_ENABLE=y
CONFIG_ESP_SLEEP_FLASH_LEAKAGE_WORKAROUND=n
CONFIG_ESP_SLEEP_GPIO_ENABLE_LIGHT_SLEEP=y

# ---------- OTA (future use) ----------
CONFIG_OTA_ALLOW_HTTP=y
CONFIG_BOOTLOADER_APP_ROLLBACK_ENABLE=y
CONFIG_BOOTLOADER_APP_SECURE_VERSION_CHECK=y

# ---------- Heap / Debug ----------
CONFIG_HEAP_POISONING_DISABLED=y
CONFIG_HEAP_TRACING_OFF=y

# ---------- Compiler ----------
CONFIG_COMPILER_OPTIMIZATION_SIZE=y
CONFIG_COMPILER_OPTIMIZATION_ASSERTIONS_ENABLE=y
```
